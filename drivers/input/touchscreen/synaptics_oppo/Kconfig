## drivers/input/touchscreen/synaptics_oppo/Kconfig
```kconfig
config TOUCHSCREEN_SYNAPTICS_OPPO
	bool "Synaptics touchscreen"
	default y
	help
	  Say Y here if you have a Synaptics touchscreen connected
	  to your system.

	  If unsure, say N.
```

## drivers/soc/oppo/Kconfig
```kconfig
config MACH_OPPO
	bool "Oppo platform"
	help
	  Support for Oppo device variants.

menu "Oppo specific options"

config OPPO_DEVICE_INFO
	bool "Oppo device info driver"
	default y if MACH_OPPO
	help
	  Say Y to enable Oppo device info driver

config OPPO_TRACE
	tristate "Oppo trace driver"
	default n
	help
	  Say Y to enable Oppo trace driver

config RECORD_MDMRST
	bool "Record modem reset"
	help
	  Say Y to record how many times the modem has restarted

endmenu
```
